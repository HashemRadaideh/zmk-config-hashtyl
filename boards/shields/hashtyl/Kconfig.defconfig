## boards/shields/hashtyl/Kconfig.defconfig
```kconfig
if SHIELD_HASHTYL_LEFT

config ZMK_KEYBOARD_NAME
    default "Hashtyl"

config ZMK_SPLIT_ROLE_CENTRAL
    default y

endif

if SHIELD_HASHTYL_LEFT || SHIELD_HASHTYL_RIGHT

config ZMK_SPLIT
    default y

endif
```

## boards/shields/hashtyl_left/Kconfig.defconfig
```kconfig
if SHIELD_HASHTYL_LEFT

config ZMK_KEYBOARD_NAME
    default "hashtyl"

config ZMK_SPLIT_ROLE_CENTRAL
    default y

endif

if SHIELD_MY_KEYBOARD_LEFT || SHIELD_MY_KEYBOARD_RIGHT

config ZMK_SPLIT
    default y

endif
```
